## firmware/components/my_board/Kconfig.projbuild
```kconfig
menu "My Audio Board"

choice CUSTOMER_AUDIO_BOARD
    prompt "My audio board"
    default MY_BOARD_SEARABOOM
    help
        Select an audio board to use with the ESP-ADF

config MY_BOARD_SEARABOOM
    bool "SearaBoom ESP32-S3-Zero/SuperMini + external I2S amp"

endchoice

endmenu
```

## firmware/main/Kconfig.projbuild
```kconfig
menu "SearaBoom Configuration"

config SEARABOOM_WIFI_SSID
    string "Default WiFi SSID"
    default ""

config SEARABOOM_WIFI_PASSWORD
    string "Default WiFi Password"
    default ""

config SEARABOOM_OTA_URL
    string "OTA base URL"
    default "https://searaboom.goossen.dev"

config SEARABOOM_LOG_URL
    string "Log ingest base URL"
    default "https://searaboom.goossen.dev"
    help
        Public OTA host is most reliable (AP client isolation / dual-NIC LAN can break LAN http).

config SEARABOOM_FW_VERSION
    string "Firmware version (keep in sync with firmware/VERSION)"
    default "0.0.1"

config SEARABOOM_I2S_DOUT
    int "I2S DOUT GPIO"
    default 2

config SEARABOOM_I2S_BCLK
    int "I2S BCLK GPIO"
    default 3

config SEARABOOM_I2S_LRC
    int "I2S LRC/WS GPIO"
    default 4

config SEARABOOM_BTN_VOL_UP
    int "Volume up touch pad GPIO (T7)"
    default 7

config SEARABOOM_BTN_VOL_DOWN
    int "Volume down touch pad GPIO (T6)"
    default 6

config SEARABOOM_LED_GPIO
    int "WS2812 LED GPIO (Zero default; SuperMini is 48 at runtime)"
    default 21

config SEARABOOM_WIFI_TIMEOUT_MS
    int "WiFi STA join timeout before quiet retry (ms)"
    default 25000
    help
        How long boot waits for a DHCP lease on a saved SSID. A timeout stays
        in STA retry — it does not start SoftAP or play the welcome clip.
        SoftAP/welcome is first-setup (or an explicit wifi wipe) only.

endmenu
```
